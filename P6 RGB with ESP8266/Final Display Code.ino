#include <ESP8266WiFi.h>
#include <ESP8266HTTPClient.h>
#include <WiFiUdp.h>
#include <NTPClient.h>
#include <TimeLib.h>
#include <Arduino_JSON.h>

#include <Adafruit_GFX.h>
#include <Fonts/Picopixel.h>
#include <Fonts/FreeMono9pt7b.h>

#include <Adafruit_BusIO_Register.h>
#include <Adafruit_I2CDevice.h>
#include <Adafruit_I2CRegister.h>
#include <Adafruit_SPIDevice.h>
#include <PxMatrix.h>

#include <Ticker.h>
Ticker display_ticker;

byte last_second, second_;
int last_minute, minute_;
int flag = 0;
int cond, humm;
String temp;

#define P_LAT 16
#define P_A 5
#define P_B 4
#define P_C 15
#define P_OE 2

#define matrix_width 32
#define matrix_height 32

uint8_t display_draw_time = 30;
const uint8_t scan_rate = 8;
PxMATRIX display(32, 32, P_LAT, P_OE, P_A, P_B, P_C);

char* ssid = "AniDGreat";
char* password = "Ani@1149";

WiFiUDP ntpUDP;
NTPClient timeClient(ntpUDP, "pool.ntp.org", 19800, 60000);

char daysOfTheWeek[7][10] = {"sun", "mon", "tue", "wed", "thu", "fri", "sat"};
char monthsOfTheYear[12][4] = {"JAN", "FEB", "MAR", "APR", "MAY", "JUN", "JUL", "AUG", "SEP", "OCT", "NOV", "DEC"};
String serverPath = "http://api.openweathermap.org/data/2.5/weather?q=Bangalore,IN&units=metric&appid=2bd5e1467bf0c19ef4f39ca5b0c9b08e";

String bigNews[5] = {
  "http://api.thingspeak.com/apps/thinghttp/send_request?api_key=CKFT8A86Q9KQQVMY",
  "http://api.thingspeak.com/apps/thinghttp/send_request?api_key=3R94GDVT9Y4OY79W",
  "http://api.thingspeak.com/apps/thinghttp/send_request?api_key=B7SSBUAJ8VZ23XNV",
  "http://api.thingspeak.com/apps/thinghttp/send_request?api_key=F1O2GRRX97GC8SIM",
  "http://api.thingspeak.com/apps/thinghttp/send_request?api_key=6Y62QF6CJD0NG4YG"
};

String gold22 = "http://api.thingspeak.com/apps/thinghttp/send_request?api_key=0REJVHJ9PJPPLL3S";
String gold24 = "http://api.thingspeak.com/apps/thinghttp/send_request?api_key=GHOMWIDAA26T68XN";

String bse = "http://api.thingspeak.com/apps/thinghttp/send_request?api_key=ZDV758E6VQSKQNNY";

String jsonBuffer;

// icon set : [Clear, Clouds, Extra 1 (scattered clouds), Extra 2 (broken clouds), Drizzle, Rain, Thunderstorm, Snow, Atmosphere]
uint8_t static weather_icons[] = {
  0x00,0x00,0x00,0x00,0x00,0x00,0x00,0x20,0x00,0x00,0x00,0x00,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0x00,
  0x00,0x00,0x00,0x00,0x00,0x00,0x00,0x00,0xff,0xe0,0x00,0x00,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0x00,
  0x00,0x00,0x00,0x00,0xff,0xe0,0x00,0x00,0x00,0x00,0x00,0x00,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0x00,
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  0x00,0x00,0x00,0x00,0x00,0x00,0x00,0x00,0x00,0x00,0x00,0x00,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0x00
};

void display_updater()
{
  display.display(10);
}

void display_update_enable(bool is_enable)
{
  if (is_enable)
    display_ticker.attach(0.002, display_updater);
  else
    display_ticker.detach();
}

void blinkTest()
{
  display.setCursor(0, 0);
  display.setTextColor(display.color565(0, 255, 255));
  display.print("Hello");
  delay(5000);

  display.setCursor(0,8);
  display.setTextColor(display.color565(255, 255, 0));
  display.print("World");
  delay(5000);
  
  display.clearDisplay();
}

void setup()
{
  Serial.begin(115200);
  display.begin(scan_rate);
  display.clearDisplay();
  display_update_enable(true);

  display.setFastUpdate(true); 
  display.setScanPattern(WZAGZIG);
  display.setColorOrder(BBGGRR);
  display.setBrightness(55);
  display.flushDisplay();

  WiFi.begin(ssid, password);
  Serial.println("WiFi");
  display.setCursor(5, 5);
  display.setTextColor(display.color565(255, 255, 255));
  display.print("WiFi");

  while ( WiFi.status() != WL_CONNECTED )
  {
    delay(500);
    Serial.print(".");
    for (int i = 0; i < 7; i++)
    {
      display.setTextColor(display.color565(255, 255, 255));
      display.setCursor(i * 4, 13);
      display.print(".");
      delay(50);
    }
    delay(50);
    for (int i = 6; i >= 0; i--)
    {
      display.setTextColor(display.color565(0, 0, 0));
      display.setCursor(i * 4, 13);
      display.print(".");
      delay(50);
    }
  }
  Serial.println("OK");
  timeClient.begin();
  display.setFont(&Picopixel);

  String jsonBuffer = httpGETRequest(serverPath.c_str());
  JSONVar myObject = JSON.parse(jsonBuffer);
  Serial.print("Open Weather Response JSON = ");
  Serial.println(myObject);
  temp = double(myObject["main"]["temp"]);
  cond = int(myObject["weather"][0]["id"]);
  humm = int(myObject["main"]["humidity"]);
}

union single_double
{
  uint8_t two[2];
  uint16_t one;
}
this_single_double;

void draw_weather_icon (uint8_t icon)
{
  if (icon > 10)
    icon = 10;
  for (int yy = 0; yy < 10; yy++)
  {
    for (int xx = 0; xx < 10; xx++)
    {
      uint16_t byte_pos = (xx + icon * 10) * 2 + yy * 220;
      this_single_double.two[1] = weather_icons[byte_pos];
      this_single_double.two[0] = weather_icons[byte_pos + 1];
      display.drawPixel(xx + 21, yy + 21, this_single_double.one);
    }
  }
}

String getValue(String data, char separator, int index)
{
    int found = 0;
    int strIndex[] = { 0, -1 };
    int maxIndex = data.length() - 1;

    for (int i = 0; i <= maxIndex && found <= index; i++) {
        if (data.charAt(i) == separator || i == maxIndex) {
            found++;
            strIndex[0] = strIndex[1] + 1;
            strIndex[1] = (i == maxIndex) ? i+1 : i;
        }
    }
    return found > index ? data.substring(strIndex[0], strIndex[1]) : "";
}

String httpGETRequest(const char* serverName)
{
  WiFiClient client;
  HTTPClient http;
  
  http.begin(client, serverName);
  int httpResponseCode = http.GET();
  String payload = "{}"; 
  
  if (httpResponseCode > 0)
  {
    Serial.print("HTTP Response code : ");
    Serial.println(httpResponseCode);
    payload = http.getString();
  }
  else
  {
    Serial.print("Error code : ");
    Serial.println(httpResponseCode);
  }
  
  http.end();
  return payload;
}

void scroll_horizontal(uint8_t ypos, unsigned long scroll_delay, String text, uint8_t colorR, uint8_t colorG, uint8_t colorB)
{
    uint16_t text_length = text.length();
    if (text_length > 250)
      return;
    display.setTextWrap(false);
    display.setTextSize(1);
    display.setRotation(0);
    display.setTextColor(display.color565(colorR, colorG, colorB));
    display.setTextColor(display.color565(50, 255, 0));
    display.fillRect(0, 14, 32, 18, display.color565(0, 0, 0));
    display.setFont(&Picopixel);
    display.setCursor(7, 19);
    display.print("NEWS");
    display.drawRect(15, 1, 2, 2, display.color565(255, 255, 255));
    display.drawRect(15, 4, 2, 2, display.color565(255, 255, 255));
    
    for (int xpos = matrix_width; xpos >- (matrix_width + text_length * 5.75); xpos--)
    {  
      display.fillRect(0, 20, 32, 12, display.color565(0, 0, 0));
      display.setTextColor(display.color565(colorR, colorG, colorB));
      display.setFont();
      display.setCursor(xpos, ypos);
      display.println(text);
      delay(scroll_delay);
      yield();

      delay(scroll_delay / 5);
      yield();
    }
    display.fillRect(0, 14, 32, 18, display.color565(0, 0, 0));
    display.setFont(&Picopixel);
}

uint8_t icon_index = 0;
void loop()
{
  timeClient.update();
  unsigned long unix_epoch = timeClient.getEpochTime();

  minute_ = timeClient.getMinutes();
  if (last_minute != minute_)
  {
    last_minute = timeClient.getMinutes();

    display.setTextColor(display.color565(255, 255, 255));
    display.clearDisplay();
    if (timeClient.getMinutes() < 10)
    {
      if (timeClient.getHours() >= 10)
        display.setCursor(1, 6);
      else
        display.setCursor(7, 6);
      display.setFont();
      display.print(String(timeClient.getHours()));
      display.setCursor(20, 0);
      display.print("0" + String(timeClient.getMinutes()));
    }
    else
    {
      if (timeClient.getHours() >= 10)
        display.setCursor(1, 6);
      else
        display.setCursor(7, 6);
      display.setFont();
      display.print(String(timeClient.getHours()));
      display.setCursor(20, 0);
      display.print(String(timeClient.getMinutes()));
    }
    
    display.setFont(&Picopixel);
    if (day(unix_epoch) >= 10)
      display.setCursor(1, 12);
    else
      display.setCursor(4, 12);
    display.setTextColor(display.color565(225, 235, 10));
    display.print(String(day(unix_epoch)));
    display.setCursor(10, 12);
    display.setTextColor(display.color565(50, 25, 145));
    display.print(monthsOfTheYear[month(unix_epoch) - 1]);
    display.setCursor(25, 12);
    display.setTextColor(display.color565(225, 30, 105));
    display.print(String(year(unix_epoch)).substring(2));

    if (WiFi.status() == WL_CONNECTED)
    {
      jsonBuffer = httpGETRequest(bigNews[timeClient.getMinutes() % 5].c_str());
      Serial.println("NEWS = " + jsonBuffer);
      scroll_horizontal(23, 20, jsonBuffer, 50, 25, 145);
    }

    if (WiFi.status() == WL_CONNECTED)
    {
      jsonBuffer = httpGETRequest(gold22.c_str());
      if (jsonBuffer.length() > 8)
      {
        Serial.println("Gold Price in Kolkata for 22 Karat / 10 gms = " + jsonBuffer);
        display.setCursor(2, 19);
        display.setTextColor(display.color565(50, 255, 0));
        display.print("22K GOLD");
      
        display.setTextColor(display.color565(225, 125, 50));
        display.setCursor(6, 28);
        display.print(jsonBuffer);
        display.drawLine(2, 23, 6, 23, display.color565(255, 153, 51)); // rupee up line
        display.drawLine(2, 25, 6, 25, display.color565(255, 153, 51)); // rupee mid line
        display.drawLine(2, 28, 5, 31, display.color565(19, 136, 8)); // rupee bottom strike
        display.drawLine(3, 23, 5, 25, display.color565(255, 153, 51)); // rupee in betweek 2 up lines
        display.drawLine(5, 26, 3, 28, display.color565(255, 255, 255)); // rupee in between middle line and bottom strike

        for (int i = 0; i <= 8; i++)
        {
          display.drawRect(15, 1, 2, 2, display.color565(255, 255, 255));
          display.drawRect(15, 4, 2, 2, display.color565(255, 255, 255));
          delay(500);
          display.drawRect(15, 1, 2, 2, display.color565(0, 0, 0));
          display.drawRect(15, 4, 2, 2, display.color565(0, 0, 0));
          delay(500);
        }
      
        display.fillRect(0, 14, 32, 18, display.color565(0, 0, 0));
      }
    }

    if (WiFi.status() == WL_CONNECTED)
    {
      jsonBuffer = httpGETRequest(bse.c_str());
      if (jsonBuffer.length() > 4 && jsonBuffer.length() < 10)
      {
        Serial.println("BSE SENSEX = " + jsonBuffer);
        display.setCursor(4, 20);
        display.setTextColor(display.color565(50, 255, 0));
        display.print("SENSEX");
        
        display.setTextColor(display.color565(225, 125, 50));
        display.setCursor(2, 28);
        display.print(jsonBuffer);
  
        for (int i = 0; i <= 8; i++)
        {
          display.drawRect(15, 1, 2, 2, display.color565(255, 255, 255));
          display.drawRect(15, 4, 2, 2, display.color565(255, 255, 255));
          delay(500);
          display.drawRect(15, 1, 2, 2, display.color565(0, 0, 0));
          display.drawRect(15, 4, 2, 2, display.color565(0, 0, 0));
          delay(500);
        }
        
        display.fillRect(0, 14, 32, 18, display.color565(0, 0, 0));
      }
    }

    display.setCursor(21, 18);
    display.setTextColor(display.color565(50, 255, 0));
    if (timeClient.getDay() == 0)
      display.setTextColor(display.color565(250, 10, 5));
    if (timeClient.getDay() == 1 or timeClient.getDay() == 3)
      display.setCursor(19, 18);
    if (timeClient.getDay() == 5)
      display.setCursor(23, 18);
    display.print(daysOfTheWeek[timeClient.getDay()]);
    
    if (WiFi.status() == WL_CONNECTED)
    {
      String jsonBuffer = httpGETRequest(serverPath.c_str());
      JSONVar myObject = JSON.parse(jsonBuffer);
      Serial.print("Open Weather Response JSON = ");
      Serial.println(myObject);
      temp = String(double(myObject["main"]["temp"])).substring(0, 2);
      cond = int(myObject["weather"][0]["id"]);
      humm = int(myObject["main"]["humidity"]);
    }
    else
    {
      String jsonBuffer = "{}";
      JSONVar myObject = JSON.parse(jsonBuffer);
      Serial.println("No Internet ...");
      temp = String(double(myObject["main"]["temp"])).substring(0, 2);
      cond = int(myObject["weather"][0]["id"]);
      humm = int(myObject["main"]["humidity"]);

      display.drawRect(15, 1, 2, 2, display.color565(255, 255, 255));
      display.drawRect(15, 4, 2, 2, display.color565(255, 255, 255));
    }
    
    
    display.setTextColor(display.color565(225, 125, 50));
    if (temp != "na")
    {
      display.setCursor(2, 20);
      display.print(temp);
      display.setCursor(10, 17);
      display.print("o");
      display.setCursor(14, 20);
      display.print("C");
    }
    else
    {
      display.setCursor(6, 20);
      display.print("It's");
    }

    
    if (humm > 0)
    {
      if (humm == 100)
      {
        display.setCursor(1, 28);
        display.print(String(humm));
        display.setFont();
        display.setCursor(12, 23);
        display.print("%");
        display.setFont(&Picopixel);
      }
      else
      {
        display.setCursor(2, 28);
        display.print(String(humm));
        display.setFont();
        display.setCursor(12, 23);
        display.print("%");
        display.setFont(&Picopixel);
      }
    }
    else
    {
      display.setCursor(0, 28);
      display.print("frozen");
      display.setFont(&Picopixel);
    }

    if (cond == 800)
      draw_weather_icon(0);
    else if (String(cond).substring(0, 2) == "80")
      draw_weather_icon(1);
    else if (String(cond).substring(0, 1) == "3")
      draw_weather_icon(4);
    else if (String(cond).substring(0, 1) == "5")
      draw_weather_icon(5);
    else if (String(cond).substring(0, 1) == "2")
      draw_weather_icon(6);
    else if (String(cond).substring(0, 1) == "6")
      draw_weather_icon(7);
    else if (String(cond).substring(0, 1) == "7")
      draw_weather_icon(8);
    else
    {
      //display.setCursor(22, 24);
      //display.print("no");
      //display.setCursor(19, 30);
      //display.print("WiFi");

      draw_weather_icon(7);
    }
    
    Serial.println(String(timeClient.getHours()) + ":" + String(timeClient.getMinutes()) + ":" + String(timeClient.getSeconds()) \
    + ", " + daysOfTheWeek[timeClient.getDay()] + ", " + monthsOfTheYear[month(unix_epoch) - 1] \
    + " " + String(day(unix_epoch)) + "/" + String(month(unix_epoch)) + "/" + year(unix_epoch));
  }

  if (flag == 1)
  {
    display.drawRect(15, 1, 2, 2, display.color565(255, 255, 255));
    display.drawRect(15, 4, 2, 2, display.color565(255, 255, 255));
  }
  else
  {
    if (WiFi.status() == WL_CONNECTED)
    {
      display.drawRect(15, 1, 2, 2, display.color565(0, 0, 0));
      display.drawRect(15, 4, 2, 2, display.color565(0, 0, 0));
    }
  }
  flag += 1;
  if (flag > 1)
    flag = 0;
  
  delay(500);
}
